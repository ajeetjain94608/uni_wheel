/**
 * Full closed-loop uni wheel balance firmware: reads IMU + both AS5600 encoders,
 * runs the trained PPO policy (actor_forward), commands both SimpleFOC-driven
 * motors.
 *
 * Hardware plumbing (I2C buses, SimpleFOC setup, pin scheme) is adapted from
 * macolin007/mcdgf (github.com/macolin007/mcdgf) - a two-wheel balance bot using
 * the identical hardware stack (ESP32 + SimpleFOC Mini x2 + AS5600 x2 + MPU6050).
 * The control loop shape (complementary filter, actor_forward() call, tip
 * detection/recovery) is adapted from the reference RL repo's balance_bot.ino,
 * which used different (M5Stack-specific) hardware - only the loop *shape* is
 * reused from there, not any of its hardware code.
 *
 * ============================================================================
 * BEFORE USING THIS FILE:
 *   1. Run sensor_test.ino first and confirm wiring/readings look sane.
 *   2. Fill in the CALIBRATION CONSTANTS section below - the axis mapping, signs,
 *      and motor directions CANNOT be known from simulation alone; they depend on
 *      how your IMU is physically mounted and which way each motor spins for a
 *      positive command. Get these wrong and the robot will actively fight
 *      itself instead of balancing - verify each one by hand before trusting it.
 *   3. Copy actor.h (generated by rl/onnx_actor_to_c.py once training is done)
 *      into this sketch folder. Currently wired for stage 05's policy (7 obs
 *      inputs, includes cmd_vel) - see workspace/software/05-command-conditioning/
 *      README.md. Verified against a real rollout: holds position within ~0.06-0.3m
 *      over 25s when cmd_vel=0, and drives in the commanded direction when nonzero -
 *      but noticeably undershoots the commanded *speed* (settles around 0.095 m/s for
 *      a cmd_vel=0.5 -> 0.25 m/s target, not just a slow ramp-up). Treat cmd_vel as a
 *      direction command more than a precise speed dial until that's improved.
 * ============================================================================
 *
 * MOTOR CONTROL CONFIRMED GOOD: voltage-mode torque control (TorqueControlType
 * ::voltage + MotionControlType::torque + motor.move(volts)), as already used
 * below, was verified smooth and correctly-commutated by running it stripped
 * of everything else - motor_spin_test.ino (angle mode, same voltage-mode FOC
 * underneath) and reaction_wheel_unicycle.ino (same voltage-mode torque
 * control, full balance loop) both confirm the driver/motor/pin setup itself
 * is right. So the SimpleFOC config below is NOT what changed - the loop
 * *structure* was. Previously this loop busy-waited the ENTIRE body (sensor
 * reads, policy inference, AND motor_wheel.loopFOC()/motor_reaction_wheel.
 * loopFOC()) down to TIMESTEP=5ms/200Hz. loopFOC() is SimpleFOC's commutation
 * update - throttling it to 200Hz starves voltage-mode FOC, which needs to
 * run much faster to stay smooth (this is almost certainly what the
 * MOTOR_DIR_REACTION_WHEEL comment below describes as a "starting-torque/
 * cogging symptom" needing a hand-nudge to spin). reaction_wheel_unicycle.ino
 * - the proven-good reference - never throttles loopFOC() at all: it calls it
 * every single iteration as fast as the hardware allows, and only gates the
 * control-law update (its Tuning()/angle_calc()/target-voltage computation)
 * behind a loop counter. This file now does the equivalent with the two
 * encoders, since SimpleFOC 2.x's loopFOC() commutates against whatever angle
 * sensor.update() last cached rather than refreshing it itself - see loop().
 *
 * (Bus 0 SDA/SCL matches the macolin007/mcdgf reference (SDA=21 SCL=22) - an
 * earlier version of this file had it swapped to 22/21 based on a wiring
 * report that turned out to be for a since-changed physical connection.
 * Separately, and still confirmed: the AS5600 sharing bus 0 with the MPU6050
 * is mounted on the REACTION wheel, not the ground wheel as mcdgf's layout
 * assumed. The motor_wheel/motor_reaction_wheel driver pins below were
 * swapped to match - each motor_init() call groups one motor+driver+sensor
 * as a physical assembly, so if the sensor was mislabeled the driver pins
 * grouped with it in code were too. Verify this against your own build
 * before trusting it - see sensor_test.ino.)
 *
 * Libraries needed (Arduino IDE Library Manager): Simple FOC (askuric), MPU6050_tockn
 */

#include <math.h>
#include <MPU6050_tockn.h>
#include <Wire.h>
#include <SimpleFOC.h>

#include "actor.h"

// ============================================================================
// CALIBRATION CONSTANTS - fill these in from sensor_test.ino before trusting
// this sketch. Every one of these is a real unknown until measured on your
// actual hardware, not a default you can leave as-is.
// ============================================================================

// Which MPU6050 axis is pitch (rotates the ground wheel forward/back) and which
// is roll (rotates the reaction wheel side to side)? Tilt the robot each way by
// hand while running sensor_test.ino and see which of angleX/angleY moves.
// Set these to +1 or -1 depending on which axis maps to which AND which sign
// direction correctly reports "leaning forward = positive pitch" (matching the
// simulation's convention, since that's what the policy was trained on).
// Measured by hand via sensor_test.ino: leaning the robot forward (top tips
// toward direction of travel - the sim's positive-pitch convention) reads
// angleX=+20 on the tockn library's printed angle. BUT the library's angleX
// is computed from raw accY, not accX (see MPU6050_tockn.cpp: angleAccX =
// atan2(accY, ...)) - so "angleX responds to pitch" means the raw Y axis
// carries pitch, i.e. IMU_PITCH_FROM_X=0. Working the sign through with that
// +20 reading gives IMU_PITCH_SIGN=-1. IMU_ROLL_SIGN still needs the
// equivalent lean-right test (see sensor_test.ino header comment for the
// sim's positive-roll convention).
#define IMU_PITCH_FROM_X 0     // 1 if raw accX/gyroX is pitch, 0 if it's accY/gyroY instead
#define IMU_PITCH_SIGN -1.0f   // verified by hand - see comment above
// Measured by hand via sensor_test.ino: leaning left reads angleY=+ on the
// tockn library's printed angle. The library bakes in a negation for angleY
// (angleAccY = atan2(accX,...) * -1), so that means raw atan2(accX,accZ) is
// actually negative at left-lean; matching the sim's positive-roll-is-lean-
// right convention with our own (non-negated) atan2(accX,accZ) formula
// confirms IMU_ROLL_SIGN=+1.
#define IMU_ROLL_SIGN 1.0f     // verified by hand - see comment above

// Motor spin direction: does a positive voltage command spin the wheel the
// direction the simulation expects (matching the "wheel_joint"/"reaction_wheel_
// joint" axis convention in uniwheel.xml)? Flip to -1 if the robot visibly fights
// itself (overcorrects wildly) rather than converging when tipped gently by hand.
// Drive wheel: CORRECTED after powered testing with motor_spin_test.ino - the
// theoretical "SimpleFOC's initFOC() self-aligns so +1 must already be
// correct" reasoning previously here was WRONG. Actual measurement: commanding
// +6V produced a sustained, real (non-noise) NEGATIVE velocity (~-72),
// opposite of what the hand-spun (unpowered) encoder-sign test suggested.
// Trust the powered measurement over the theory - flip to -1.
const int MOTOR_DIR_WHEEL = -1;
// Reaction wheel: still only hand-spin-inferred (-1, see below), NOT powered-
// confirmed - the powered test on this wheel was inconclusive (readings
// stayed small/erratic instead of showing a clean ramp like the drive wheel
// did) and it was separately observed needing a manual hand-nudge before it
// would spin under motor power at all. That's a starting-torque/cogging
// symptom (common in simple voltage-mode FOC at low speed), not something a
// direction-sign flip fixes - if the real balance loop's small corrective
// commands can't produce enough torque to break static friction on this
// wheel, roll correction may be ineffective in practice. Needs a clean
// re-test (own initFOC() status, and actual sign once spinning under power)
// before trusting this value with real confidence.
//
// Original hand-spin reasoning (unpowered, encoder-only): spinning it
// clockwise as viewed from the front of the robot (where it would drive
// toward you) read vel=+ on the raw encoder. The sim's positive convention is
// angular momentum pointing toward the robot's front, i.e. toward that same
// viewer - by the right-hand rule, a vector pointing at the viewer looks
// COUNTERclockwise to them, not clockwise. So the observed clockwise-positive
// is inverted relative to the sim; flip with -1.
const int MOTOR_DIR_REACTION_WHEEL = -1;

// ============================================================================
// Pin scheme (from macolin007/mcdgf's pin-table.xlsx - confirm against your own
// wiring, don't assume it matches without checking)
// ============================================================================
#define M0_I2C_SDA 21  // reaction wheel AS5600 + MPU6050 (shared bus)
#define M0_I2C_SCL 22
#define M1_I2C_SDA 19  // ground/drive wheel AS5600 (separate bus - AS5600's I2C
#define M1_I2C_SCL 18  // address is fixed, can't share a bus with another AS5600)

// ============================================================================
// Settings (match training - see workspace/software/02-balance-bot-with-ppo/
// uniwheel_env.py and workspace/mechanical/urdf/uniwheel/uniwheel.xml)
// ============================================================================
const float COMP_ALPHA = 0.98f;      // complementary filter weight - MUST match uniwheel_env.py
const float TIMESTEP = 0.005f;       // sim timestep (sec) - MUST match uniwheel.xml <option timestep>
const float TIP_THRESHOLD = 0.524f;  // radians (30 deg) - MUST match uniwheel_env.py's tip_threshold_deg
const float VOLTAGE_LIMIT = 6.0f;    // volts - conservative default from the mcdgf reference build
const float MOTOR_PHASE_RESISTANCE = 2.3f;  // ohms - FIT1034 datasheet value (not mcdgf's 2804 motor's 2.9)
const int MOTOR_POLE_PAIRS = 7;      // FIT1034 datasheet value
const unsigned long RESET_TIME_MS = 1000;

// ============================================================================
// Hardware objects
// ============================================================================
TwoWire I2C_0 = TwoWire(0);
TwoWire I2C_1 = TwoWire(1);

MagneticSensorI2C sensor_wheel = MagneticSensorI2C(AS5600_I2C);
MagneticSensorI2C sensor_reaction_wheel = MagneticSensorI2C(AS5600_I2C);
MPU6050 mpu6050(I2C_0);

BLDCMotor motor_wheel = BLDCMotor(MOTOR_POLE_PAIRS);
BLDCDriver3PWM driver_wheel = BLDCDriver3PWM(26, 27, 14, 13);  // was grouped with the
// reaction wheel's sensor in mcdgf's layout - swapped to match the confirmed sensor swap.
// Phase order (A/C) corrected from (14,27,26,13) per hardware verification.

BLDCMotor motor_reaction_wheel = BLDCMotor(MOTOR_POLE_PAIRS);
BLDCDriver3PWM driver_reaction_wheel = BLDCDriver3PWM(33, 32, 25, 12);  // was grouped
// with the ground wheel's sensor in mcdgf's layout - swapped to match. Phase order
// (A/C) corrected from (25,32,33,12) per hardware verification.

// ============================================================================
// State
// ============================================================================
float pitch = 0.0f;
float roll = 0.0f;
bool tipped = false;

void sensors_init() {
  I2C_0.begin(M0_I2C_SDA, M0_I2C_SCL, 100000);
  sensor_reaction_wheel.init(&I2C_0);  // bus 0 is the reaction wheel's encoder

  I2C_1.begin(M1_I2C_SDA, M1_I2C_SCL, 100000);
  sensor_wheel.init(&I2C_1);  // bus 1 is the ground/drive wheel's encoder

  mpu6050.begin();
  Serial.println("Calibrating gyro - keep the robot still...");
  mpu6050.calcGyroOffsets(true);
}

void motor_init(BLDCMotor& motor, BLDCDriver3PWM& driver, MagneticSensorI2C& sensor) {
  motor.linkSensor(&sensor);
  driver.voltage_power_supply = 12;
  driver.voltage_limit = VOLTAGE_LIMIT;
  driver.init();
  motor.phase_resistance = MOTOR_PHASE_RESISTANCE;
  motor.torque_controller = TorqueControlType::voltage;
  motor.linkDriver(&driver);
  motor.foc_modulation = FOCModulationType::SpaceVectorPWM;
  motor.controller = MotionControlType::torque;
  motor.voltage_limit = VOLTAGE_LIMIT;
  motor.useMonitoring(Serial);
  motor.init();
  motor.initFOC();
}

void setup() {
  Serial.begin(115200);
  while (!Serial);
  Serial.println("Uni wheel balance bot");

  sensors_init();
  motor_init(motor_wheel, driver_wheel, sensor_wheel);
  motor_init(motor_reaction_wheel, driver_reaction_wheel, sensor_reaction_wheel);

  Serial.printf("Starting in %lu ms, place robot upright\n", RESET_TIME_MS);
  delay(RESET_TIME_MS);
  Serial.println("Running...");
}

void loop() {
  // Refresh both encoders and run FOC commutation every iteration, as fast
  // as the hardware allows - NOT paced to TIMESTEP. This is what the
  // proven-good voltage-mode examples do (see header comment) and it's what
  // actually determines how smooth voltage-mode FOC feels; the policy's
  // control rate below is a separate, much slower concern.
  sensor_wheel.update();
  sensor_reaction_wheel.update();
  motor_wheel.loopFOC();
  motor_reaction_wheel.loopFOC();

  // Everything else - sensor fusion, the policy, new motor targets - only
  // needs to run at TIMESTEP (matching the sim's control rate, which the
  // policy was trained against). Gate it with a non-blocking elapsed-time
  // check instead of busy-waiting, so loopFOC() above keeps running at full
  // native speed in between control updates.
  static unsigned long last_control = 0;
  unsigned long now = micros();
  if (now - last_control < (unsigned long)(TIMESTEP * 1e6f)) return;
  last_control = now;

  mpu6050.update();

  // Raw IMU: MPU6050_tockn reports accel in g's (ratio - no unit conversion
  // needed for atan2) and gyro in deg/s (DOES need conversion to rad/s to match
  // what the policy was trained on).
  float accX = mpu6050.getAccX();
  float accY = mpu6050.getAccY();
  float accZ = mpu6050.getAccZ();
  float pitch_rate = IMU_PITCH_SIGN * (IMU_PITCH_FROM_X ? mpu6050.getGyroX() : mpu6050.getGyroY())
                      * (M_PI / 180.0f);
  float roll_rate = IMU_ROLL_SIGN * (IMU_PITCH_FROM_X ? mpu6050.getGyroY() : mpu6050.getGyroX())
                      * (M_PI / 180.0f);

  // Same complementary filter as uniwheel_env.py's _get_obs() - keep these
  // formulas in sync if that ever changes, or the policy will see a
  // systematically different signal than it was trained on.
  // (Must pick the same raw axis IMU_PITCH_FROM_X selects for the gyro terms
  // above - previously this always used accX/accY regardless of the flag,
  // which would silently fuse a gyro rate from one axis with an accel angle
  // from the other whenever IMU_PITCH_FROM_X=0.)
  float accel_pitch = IMU_PITCH_SIGN * -atan2f(IMU_PITCH_FROM_X ? accX : accY, accZ);
  float accel_roll = IMU_ROLL_SIGN * atan2f(IMU_PITCH_FROM_X ? accY : accX, accZ);
  pitch = COMP_ALPHA * (pitch + pitch_rate * TIMESTEP) + (1.0f - COMP_ALPHA) * accel_pitch;
  roll = COMP_ALPHA * (roll + roll_rate * TIMESTEP) + (1.0f - COMP_ALPHA) * accel_roll;

  float wheel_vel = MOTOR_DIR_WHEEL * sensor_wheel.getVelocity();
  float reaction_wheel_vel = MOTOR_DIR_REACTION_WHEEL * sensor_reaction_wheel.getVelocity();

  if (fabsf(pitch) > TIP_THRESHOLD || fabsf(roll) > TIP_THRESHOLD) {
    tipped = true;
  }

  if (!tipped) {
    // Observation order MUST match uniwheel_env_cmd.py's _get_obs() exactly:
    // [pitch, roll, pitch_rate, roll_rate, wheel_vel, reaction_wheel_vel, cmd_vel]
    // cmd_vel is a placeholder (0 = "hold position") until stage 06 wires up a real
    // remote-control input here - normalized [-1,1], scaled to vel_max=0.5 m/s by
    // the trained policy itself, same convention as training.
    float cmd_vel = 0.0f;
    float obs[ACTOR_OBS_SIZE] = {pitch, roll, pitch_rate, roll_rate, wheel_vel,
                                  reaction_wheel_vel, cmd_vel};
    float action[ACTOR_ACTION_SIZE];
    actor_forward(obs, action);

    action[0] = constrain(action[0], -1.0f, 1.0f);
    action[1] = constrain(action[1], -1.0f, 1.0f);

    // Voltage-mode torque control: target is a voltage, not a literal torque or
    // angle. Scaling by VOLTAGE_LIMIT maps the policy's [-1,1] action directly
    // onto the driver's configured voltage ceiling.
    motor_wheel.move(MOTOR_DIR_WHEEL * action[0] * VOLTAGE_LIMIT);
    motor_reaction_wheel.move(MOTOR_DIR_REACTION_WHEEL * action[1] * VOLTAGE_LIMIT);
  } else {
    motor_wheel.move(0);
    motor_reaction_wheel.move(0);

    // Wait for someone to set it upright again before resuming
    if (fabsf(pitch) < 0.1f && fabsf(roll) < 0.1f) {
      tipped = false;
      Serial.printf("Untipped! Starting in %lu ms\n", RESET_TIME_MS);
      delay(RESET_TIME_MS);
      Serial.println("Running...");
    }
  }
}
